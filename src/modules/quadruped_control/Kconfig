## src/modules/quadruped_control/Kconfig
```kconfig
menuconfig MODULES_QUADRUPED_CONTROL
    bool "quadruped_control"
    default n
    ---help---
        Enable quadruped control module
```

## src/modules/quadruped_gait/Kconfig
```kconfig
menuconfig MODULES_QUADRUPED_GAIT
	bool "quadruped_gait"
	default n
	---help---
		Enable quadruped gait controller

config MODULES_QUADRUPED_GAIT_RC
	bool "quadruped_gait_rc"
	default n
	---help---
		Publish gait commands from RC inputs
```

## src/modules/simulation/gz_plugins/Kconfig
```kconfig
menuconfig MODULES_SIMULATION_GZ_PLUGINS
        bool "gz_plugins"
        default n
        depends on PLATFORM_POSIX && MODULES_SIMULATION_GZ_MSGS
        ---help---
                Enable support for gz_plugins

if MODULES_SIMULATION_GZ_PLUGINS

config MODULES_SIMULATION_GZ_PLUGINS_WHEEL_ENCODER
       bool "Wheel encoder simulation plugin"
       default y

endif
```
